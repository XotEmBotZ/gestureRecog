## esp/sdkconfig.defaults
```kconfig
# Console Redirect to USB-C Serial/JTAG
CONFIG_ESP_CONSOLE_USB_SERIAL_JTAG=y
CONFIG_ESP_CONSOLE_UART_DEFAULT=n
CONFIG_ESP_CONSOLE_SECONDARY_USB_SERIAL_JTAG=n

# Bluetooth
CONFIG_BT_ENABLED=y
CONFIG_BT_NIMBLE_ENABLED=y
CONFIG_BT_NIMBLE_EXT_ADV=n

# Maximum TX Power for better range/visibility
CONFIG_BT_CTRL_DFT_TX_PWER_LEVEL_P9=y

# NimBLE Configuration
CONFIG_BT_NIMBLE_MAX_CONNECTIONS=3
CONFIG_BT_NIMBLE_MAX_SERVICES=15
CONFIG_BT_NIMBLE_MAX_CHRC_DEFS=30
CONFIG_BT_NIMBLE_MAX_GVAS=10
CONFIG_BT_NIMBLE_MAX_GATTS_ATTRS=60

# MSYS buffers (Crucial for stability)
CONFIG_BT_NIMBLE_MSYS_1_BLOCK_COUNT=32

# Disable Extended Advertising for maximum compatibility with all phones
CONFIG_BT_NIMBLE_EXT_ADV=n

# Power Management (Disable for stable BLE)
CONFIG_PM_ENABLE=n

# CPU Frequency
CONFIG_ESP_DEFAULT_CPU_FREQ_MHZ_240=y
```
